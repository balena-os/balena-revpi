## layers/meta-resin-revpi-core-3/conf/machine/revpi-core-3.conf
```bitbake
#@TYPE: Machine
#@NAME: Revolution Pi Core 3
#@DESCRIPTION: Machine configuration for Revolution Pi Core 3 board

MACHINEOVERRIDES = "raspberrypi3:${MACHINE}"
include conf/machine/raspberrypi3.conf

PREFERRED_PROVIDER_virtual/kernel = "linux-kunbus"

PREFERRED_VERSION_linux-raspberrypi = "4.9.%"

KERNEL_DEVICETREE_append = " \
	overlays/kunbus.dtbo \
"

# Remove rpi-3-b-plus if building 4.9 kernel, as the dtb is not included in the repo
# TODO: Go the other way, and add the bcm2710-rpi-3-b-plus.dtb if building 4.9 kernel
KERNEL_DEVICETREE_remove = " \
	bcm2710-rpi-3-b-plus.dtb \
"

KERNEL_MODULE_AUTOLOAD += "piControl"
```
